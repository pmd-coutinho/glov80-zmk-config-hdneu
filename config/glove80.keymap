
/*
 * Copyright (c) 2020 The ZMK Contributors
 * Copyright (c) 2023 Innaworks Development Limited, trading as MoErgo
 *
 * SPDX-License-Identifier: MIT
 */


/* THIS FILE WAS GENERATED BY GLOVE80 LAYOUT EDITOR
 *
 * This file was generated automatically. You may or may not want to
 * edit it directly.
 */

#include <behaviors.dtsi>
/* Include all behavior includes needed */
#include <dt-bindings/zmk/outputs.h>
#include <dt-bindings/zmk/keys.h>
#include <dt-bindings/zmk/bt.h>
#include <dt-bindings/zmk/rgb.h>

/* Automatically generated layer name #define */
#define LAYER_HandsDownNeu 0
#define LAYER_QWERTY 1
#define LAYER_Symbol 2
#define LAYER_Number 3
#define LAYER_Function 4
#define LAYER_Cursor 5
#define LAYER_SelectCont 6
#define LAYER_SelectContSL 7
#define LAYER_Mouse 8
#define LAYER_akl_A 9
#define LAYER_akl_C 10
#define LAYER_akl_G 11
#define LAYER_akl_P 12
#define LAYER_akl_B 13
#define LAYER_akl_D 14
#define LAYER_akl_M 15
#define LAYER_akl_U 16
#define LAYER_Lower 17
#define LAYER_Magic 18

/* Base layers for limiting Combo scope */
#define BASE_LAYERS LAYER_HandsDownNeu LAYER_QWERTY LAYER_akl_A LAYER_akl_C LAYER_akl_G LAYER_akl_P LAYER_akl_B LAYER_akl_D LAYER_akl_M LAYER_akl_U

/* To deal with the situation where there is no Lower layer, to keep &lower happy */
#ifndef LAYER_Lower
#define LAYER_Lower 0
#endif

/* Custom Device-tree */

/* Macro timers; can be increased for systems that don't like 0ms Macros */
#define FAST_MACRO_TAP_MS 0
#define FAST_MACRO_WAIT_MS 0

/* How long to hold to activate home row mods for same side or mouse usage */
#define HOME_ROW_MODS_TAPPING_TERM_MS 300

/* Cool down after typing before home row mods can be used */
#define HOME_ROW_MODS_REQUIRE_PRIOR_IDLE_MS 175

/* How quickly to double tap home row mods to hold down the tap action */
#define HOME_ROW_MODS_QUICK_TAP_MS 200

#define ADAPTIVE_LAYER_TIMEOUT_MS 100

/* How long to hold for Autoshift */
#define AUTOSHIFT_TAPPING_TERM_MS 200

/* How long thumb keys can be held before rolls send the higher layer key */
#define THUMBS_TAPPING_TERM_MS 200

/* How quickly to double tap repeating thumb keys to hold the tap action */
#define REPEATING_THUMBS_QUICK_TAP_MS 250

#define CUSTOM_MOD_TAP_TERM_MS 200

#define ALT_TAB_TIMEOUT_MS 500

/* How long until the word and line selection feature times out */
#define SELECT_TIMEOUT_MS 60000

/* How quickly Combo keys must be pressed together */
#define COMBO_TIMEOUT_MS 25
#define SLOW_COMBO_TIMEOUT_MS 50

/* How quickly both thumb Shift keys must be pressed together to activate Caps
   Word */
#define CAPS_WORD_COMBO_TIMEOUT_MS 150

#define MOD_TAP_PROPS \
    compatible = "zmk,behavior-hold-tap"; \
    tapping_term_ms = <CUSTOM_MOD_TAP_TERM_MS>; \
    flavor = "hold-preferred"; \
    #binding-cells = <2>;

/*****************************************************************************/
                            /* Layer Conditions */
/*****************************************************************************/

/* Conditional Layer helper */
#define LAYER_CONDITION(NAME, IF, THEN) \
    NAME { \
        if-layers = <IF>; \
        then-layer = <THEN>; \
    };

/ {
    conditional_layers {
        compatible = "zmk,conditional-layers";

        /* Restrict selection continuation to Editing layer */
        LAYER_CONDITION(continue_selection, LAYER_Cursor LAYER_SelectContSL, LAYER_SelectCont)
    };
};

/*****************************************************************************/
                        /* Basic Helper C Macros */
/*****************************************************************************/

#define ZMK_COMBO(NAME, TIMEOUT_MS, KEY_POSITIONS, LAYERS, BINDINGS) \
    NAME { \
        timeout-ms = <TIMEOUT_MS>; \
        key-positions = <KEY_POSITIONS>; \
        layers = <LAYERS>; \
        bindings = <BINDINGS>; \
    }; \

/* Wrap ZMK_MACRO to avoid needing to specify Macro node */
#define ZMKMACRO(NAME, ...) \
    / { \
        macros { \
            ZMK_MACRO(NAME, __VA_ARGS__) \
        }; \
    };

/* Instant key press Macro helper using defined timers */
#define FAST_MACRO(NAME, BINDINGS) \
    ZMKMACRO(NAME, \
        tap-ms = <FAST_MACRO_TAP_MS>; \
        wait-ms = <FAST_MACRO_WAIT_MS>; \
        bindings = <BINDINGS>; \
    )

/* Create a ZMK Behavior without having to specify the name three times */
#define ZMK_BEHAVIOR(NAME, ...) \
    / { \
        behaviors { \
            NAME: NAME { \
                __VA_ARGS__ \
            }; \
        }; \
    };

/* Hold-Tap helper */
#define HOLD_TAP(NAME, ...) \
    ZMK_BEHAVIOR(NAME, \
        compatible = "zmk,behavior-hold-tap"; \
        #binding-cells = <2>; \
        __VA_ARGS__ \
    )

/* Balanced Hold-Tap for home row mods and thumb layer keys */
#define BALANCED_HOLD_TAP(NAME, ...) \
    HOLD_TAP(NAME, \
        flavor = "balanced";  /* Fast hold */ \
        __VA_ARGS__ \
    )

/* Mod-Morph helper */
#define MOD_MORPH(NAME, STANDARD, MORPHED, MODS, ...) \
    ZMK_BEHAVIOR(NAME, \
        compatible = "zmk,behavior-mod-morph"; \
        #binding-cells = <0>; \
        bindings = <STANDARD>, <MORPHED>; \
        mods = <(MODS)>; \
        __VA_ARGS__ \
    )

#define INST_MACRO(NAME, ...) \
    ZMK_MACRO(NAME, \
        wait-ms = <0>; \
        tap-ms = <0>; \
        __VA_ARGS__ \
    )

#define INST_VIM_CMD_MACRO(NAME, CMD) \
    INST_MACRO(NAME, \
        bindings = <&kp ESC &kp COLON CMD &kp ENTER>; \
    )

#define DIGRAM_MACRO(A, B) \
    INST_MACRO(A ## B, \
        bindings = <&kp A &kp B>; \
    )

#define AK_MACRO(KEY) \
    INST_MACRO(AK_ ## KEY, \
        bindings = <&kp KEY>, <&aksl LAYER_akl_ ## KEY>; \
    )

#define AK_FIXUP_MACRO(KEY1, KEY2) \
    INST_MACRO(AK_ ## KEY1 ## KEY2, \
        bindings = <&kp BSPC>, <&kp KEY1>, <&kp KEY2>; \
    )

/* Mod-Morph that sends another key when Alt is held */
#define ALT_MORPH(NAME, PRIMARY, ALTERNATE) \
    MOD_MORPH(NAME, PRIMARY, ALTERNATE, MOD_LALT|MOD_RALT)

/* Mod-Morph that sends another key when Shift is held */
#define SHIFT_MORPH(NAME, LOWER, UPPER) \
    MOD_MORPH(NAME, LOWER, UPPER, MOD_LSFT|MOD_RSFT)

#define LAYER_COMBO(NAME, LAYER_NAME, ...) \
    combo_ ## NAME { \
        layers = <LAYER_ ## LAYER_NAME>; \
        timeout-ms = <SLOW_COMBO_TIMEOUT_MS>; \
        __VA_ARGS__ \
    };

#define FAST_LAYER_COMBO(NAME, LAYER_NAME, ...) \
    combo_ ## NAME { \
        layers = <LAYER_ ## LAYER_NAME>; \
        timeout-ms = <COMBO_TIMEOUT_MS>; \
        __VA_ARGS__ \
    };

/*****************************************************************************/
                                /* Combos */
/*****************************************************************************/

/* Limit to base layers and use defined timer for most Combos */
#define COMBO(NAME, KEY_POSITIONS, BINDINGS) \
    ZMK_COMBO(NAME, COMBO_TIMEOUT_MS, KEY_POSITIONS, BASE_LAYERS, BINDINGS)

/ {
    combos {
        compatible = "zmk,combos";

        // Left-hand bottom row combos based on Hands Down
        // Outputs are QWERTY shortcuts
        // X+F -> Ctrl+Z
        LAYER_COMBO(undo, HandsDownNeu,
            bindings = <&kp LG(Z)>;
            key-positions = <47 48>;
        )
        // X+L -> Ctrl+X
        LAYER_COMBO(cut, HandsDownNeu,
            bindings = <&kp LG(X)>;
            key-positions = <47 49>;
        )
        // F+L -> Ctrl+C
        FAST_LAYER_COMBO(copy, HandsDownNeu,
            bindings = <&kp LG(C)>;
            key-positions = <48 49>;
        )
        // L+C -> Ctrl+V
        FAST_LAYER_COMBO(paste, HandsDownNeu,
            bindings = <&kp LG(V)>;
            key-positions = <49 50>;
        )
        // X+F+L -> Ctrl+Shift+C
        LAYER_COMBO(copy_shift, HandsDownNeu,
            bindings = <&kp LG(LS(C))>;
            key-positions = <47 48 49>;
        )
        // F+L+C -> Ctrl+Shift+V
        LAYER_COMBO(paste_shift, HandsDownNeu,
            bindings = <&kp LG(LS(V))>;
            key-positions = <48 49 50>;
        )

        // Hands Down combos
        // uy -> qu
        FAST_LAYER_COMBO(qu, HandsDownNeu,
            bindings = <&QU>;
            key-positions = <59 61>;
        )

        /* Escape with left home thumb (Space) and left upper pinky (Q) */
        COMBO(combo_esc, 23 69, &kp ESC)

        /* Caps Word with left and right upper inner thumb keys (Shift) using
        defined timer */
        ZMK_COMBO(combo_caps_word, CAPS_WORD_COMBO_TIMEOUT_MS, 52 57, \
            BASE_LAYERS, &caps_word \
        )
    };
};

/*****************************************************************************/
                            /* Home Row Mods */
/*****************************************************************************/

/* "Timerless" home row mod Hold-Tap using defined timers */
#define HOME_ROW_MOD_HELPER(NAME, KEY_POSITIONS, TAP) \
    BALANCED_HOLD_TAP(NAME, \
        tapping-term-ms = <HOME_ROW_MODS_TAPPING_TERM_MS>;  /* Mouse usage */ \
        quick-tap-ms = <HOME_ROW_MODS_QUICK_TAP_MS>;  /* Double tap repeat */ \
        /* Lockout when typing quickly */ \
        require-prior-idle-ms = <HOME_ROW_MODS_REQUIRE_PRIOR_IDLE_MS>; \
        hold-trigger-key-positions = <KEY_POSITIONS>;  /* Use other hand */ \
        hold-trigger-on-release;  /* Enable chording mods */ \
        bindings = <&kp>, <TAP>; \
    )

/* Left hand key positions for use with right hand mods */
#define LEFT_HAND_KEYS \
    /*    ┌────┬────┬────┬────┬────┐                                       */ \
             0    1    2    3    4                                            \
    /*    ├────┼────┼────┼────┼────┼────┐                                  */ \
            10   11   12   13   14   15                                       \
    /*    ├────┼────┼────┼────┼────┼────┤                                  */ \
            22   23   24   25   26   27                                       \
    /*    ├────┼────┼────┼────┼────┼────┤                                  */ \
            34   35   36   37   38   39                                       \
    /*    ├────┼────┼────┼────┼────┼────┤                                  */ \
            46   47   48   49   50   51                                       \
    /*    ├────┼────┼────┼────┼────┼────┘                                  */ \
            64   65   66   67   68
    /*    └────┴────┴────┴────┴────┘                                       */

/* Right hand key positions for use with left hand mods */
#define RIGHT_HAND_KEYS \
    /*                                          ┌────┬────┬────┬────┬────┐ */ \
                                                   5    6    7    8    9      \
    /*                                     ┌────┼────┼────┼────┼────┼────┤ */ \
                                             16   17   18   19   20   21      \
    /*                                     ├────┼────┼────┼────┼────┼────┤ */ \
                                             28   29   30   31   32   33      \
    /*                                     ├────┼────┼────┼────┼────┼────┤ */ \
                                             40   41   42   43   44   45      \
    /*                                     ├────┼────┼────┼────┼────┼────┤ */ \
                                             58   59   60   61   62   63      \
    /*                                     └────┼────┼────┼────┼────┼────┤ */ \
                                                  75   76   77   78   79
    /*                                          └────┴────┴────┴────┴────┘ */

/* Thumb key positions for use with mods on both hands */
#define THUMB_KEYS \
    /*                 ┌────┬────┬────┐      ┌────┬────┬────┐              */ \
                         52   53   54          55   56   57                   \
    /*                 ├────┼────┼────┤      ├────┼────┼────┤              */ \
                         69   70   71          72   73   74
    /*                 └────┴────┴────┘      └────┴────┴────┘              */ 


/* Left and right hand home row mods */
#define HOME_ROW_MOD_LH(NAME, TAP) \
    HOME_ROW_MOD_HELPER(NAME, RIGHT_HAND_KEYS THUMB_KEYS, TAP)
#define HOME_ROW_MOD_RH(NAME, TAP) \
    HOME_ROW_MOD_HELPER(NAME, LEFT_HAND_KEYS THUMB_KEYS, TAP)

HOME_ROW_MOD_LH(lh_hr_mt, &kp)  /* Left hand */
HOME_ROW_MOD_RH(rh_hr_mt, &kp)  /* Right hand */
HOME_ROW_MOD_RH(rh_hr_mt_aka, &AK_A)  /* Right thumb */

/*****************************************************************************/
                            /* Thumb Layer Keys */
/*****************************************************************************/

/* Home thumb layer tap without quick tap; faster layer switching */
#define FAST_SWITCHING_THUMB_LAYER_TAP(NAME, TAP_BINDING) \
    BALANCED_HOLD_TAP(NAME, \
        tapping-term-ms = <THUMBS_TAPPING_TERM_MS>;  /* Rolls send tap key */ \
        bindings = <&mo>, <TAP_BINDING>; \
    )

/* Reaching thumb layer tap with double tap to repeat */
#define REPEATING_THUMB_LAYER_TAP(NAME, TAP_BINDING) \
    BALANCED_HOLD_TAP(NAME, \
        tapping-term-ms = <THUMBS_TAPPING_TERM_MS>;  /* Rolls send tap key */ \
        quick-tap-ms = <REPEATING_THUMBS_QUICK_TAP_MS>;  /* 2x tap repeats */ \
        bindings = <&mo>, <TAP_BINDING>; \
    )

/* Used on Base, Editing and Numbers layers to enable fast switching */
FAST_SWITCHING_THUMB_LAYER_TAP(fst_lt, &kp)

/* Used on Media and Function layers for Tab and Enter to enable hold to 
   repeat */
REPEATING_THUMB_LAYER_TAP(rt_lt, &kp)


/*****************************************************************************/
                    /* Numbers Layer Custom Shifted Pairs */
/*****************************************************************************/

/* Autoshift Behavior using defined timer */
#define AUTOSHIFT(NAME, HOLD, TAP) \
    HOLD_TAP(NAME, \
        flavor = "tap-preferred"; \
        tapping-term-ms = <AUTOSHIFT_TAPPING_TERM_MS>;  /* Hold for Shift */ \
        bindings = <HOLD>, <TAP>; \
    )

AUTOSHIFT(as, &kp, &kp)  /* Main Autoshift Behavior */

/* Autoshifting Mod-Morph Behavior that sends another key when Shift is held */
#define AUTOSHIFT_MORPH(NAME, LOWER, UPPER) \
    SHIFT_MORPH(NAME, &as UPPER LOWER, &kp UPPER)

AUTOSHIFT_MORPH(as_f9_f10, F9, F10)
AUTOSHIFT_MORPH(as_f11_f12, F11, F12)
AUTOSHIFT_MORPH(as_fs_cm, FSLH, COMMA)
AUTOSHIFT_MORPH(as_am_dt, AMPS, DOT)
AUTOSHIFT_MORPH(as_qm_ex, QMARK, EXCL)
AUTOSHIFT_MORPH(as_dq_sq, DQT, SQT)
AUTOSHIFT_MORPH(as_cl_sm, COLON, SEMI)
AUTOSHIFT_MORPH(as_mn_und, KP_MINUS, UNDER)

/*****************************************************************************/
                        /* Triple Function Shift Keys */
/*****************************************************************************/

/* Instant Caps Lock on Mac OS */
ZMKMACRO(instant_caps_lock, \
    tap-ms = <200>;  /* Mac OS ignores short taps on Caps Lock */
    bindings = <&kp CAPS>;
)

/* Triple function left Shift */
MOD_MORPH(lshft_caps, &sk LSHFT, &instant_caps_lock, MOD_LSFT)

/* Triple function right Shift with Mac/PC support */
MOD_MORPH(rshft_bspcwd_mac, &sk RSHFT, &kp LA(BACKSPACE), MOD_RSFT)
MOD_MORPH(rshft_bspcwd_pc, &sk RSHFT, &kp LC(BACKSPACE), MOD_RSFT)

/*****************************************************************************/
                /* Editing Layer Alternative Shortcuts */
/*****************************************************************************/

/* Editing layer alternative shortcuts with Mac/PC support */
ALT_MORPH(copy_sel_all_mac, &kp LG(C), &kp LG(A))
ALT_MORPH(copy_sel_all_pc, &kp LC(C), &kp LC(A))
ALT_MORPH(paste_undo_mac, &kp LG(V), &kp LG(Z))
ALT_MORPH(paste_undo_pc, &kp LC(V), &kp LC(Z))

/*****************************************************************************/
                /* Sticky Layer State Machine Helper C Macros */
/*****************************************************************************/

/* Sticky Layer Behavior definition helper */
#define STICKY_LAYER_HELPER(NAME, TIMEOUT_MS, ...) \
    ZMK_BEHAVIOR(NAME, \
        compatible = "zmk,behavior-sticky-key"; \
        #binding-cells = <1>; \
        release-after-ms = <TIMEOUT_MS>;  /* Release if no key is pressed */ \
        bindings = <&mo>; \
        __VA_ARGS__ \
    )

/* State transition macro that allows taking an action after key release, at
   the cost of not supporting rolls into the next state. */
#define STATE_TRANSITION_WITH_EXIT(NAME, ENTRY, ACTION_BINDING, EXIT, \
                                   SL_BEHAVIOR, NEXT_STATE_LAYER) \
    FAST_MACRO(NAME, \
        ENTRY  /* Optional setup, pass &macro_tap &... */ \
        &macro_press ACTION_BINDING  /* Main action */ \
        &macro_pause_for_release  /* Hold for repeating key press */ \
        &macro_release ACTION_BINDING \
        EXIT \
        &macro_tap SL_BEHAVIOR NEXT_STATE_LAYER  /* Move to next state */ \
    )

/* Quick release Sticky Layer that does not ignore modifiers */
#define STICKY_LAYER_NO_MODS(NAME, TIMEOUT_MS) \
    STICKY_LAYER_HELPER(NAME, TIMEOUT_MS, \
        quick-release;  /* Release as soon as another key is pressed */ \
        /delete-property/ ignore-modifiers;  /* Mods release Sticky Layer */ \
    )

/*****************************************************************************/
                        /* Word & Line Selection */
/*****************************************************************************/

/* Quick release Sticky Layer Behavior that does not ignore modifiers using
   defined timer for continuing the word and line selection feature */
STICKY_LAYER_NO_MODS(sl_select_cont, SELECT_TIMEOUT_MS)

/* Select Macro definition helper */
#define SELECT_HELPER(NAME, SETUP, SELECTION_BINDING, CLEANUP) \
    STATE_TRANSITION_WITH_EXIT(NAME, SETUP, SELECTION_BINDING, CLEANUP, \
        &sl_select_cont, LAYER_SelectContSL)

/* Select word start Macro helper */
#define SELECT_WORD_START_MACRO(NAME, SETUP_BINDINGS, SELECTION_BINDING) \
    SELECT_HELPER(NAME, &macro_tap SETUP_BINDINGS, SELECTION_BINDING, \
        /* No CLEANUP */)

/* Select word continue Macro helper */
#define SELECT_WORD_CONT_MACRO(NAME, SELECTION_BINDING) \
    SELECT_HELPER(NAME, /* No SETUP */, SELECTION_BINDING, /* No CLEANUP */)

/* Select line start Macro helper */
#define SELECT_LINE_START_MACRO(NAME, SETUP_BINDINGS, SELECTION_BINDING, \
                                CLEANUP_BINDINGS) \
    SELECT_HELPER(NAME, &macro_tap SETUP_BINDINGS, SELECTION_BINDING, \
        &macro_tap CLEANUP_BINDINGS)

/* Select line continue Macro helper */
#define SELECT_LINE_CONT_MACRO(NAME, SELECTION_BINDING, CLEANUP_BINDINGS) \
    SELECT_HELPER(NAME, /* No SETUP */, SELECTION_BINDING, \
        &macro_tap CLEANUP_BINDINGS)

/* Movement, jumping and selection helper macros */
#define MAC_WF   LA(RIGHT)              /* Jump forward a word on Mac */
#define MAC_WB   LA(LEFT)               /* Jump backward a word on Mac */
#define MAC_HOME LG(LEFT)               /* Jump to start of line on Mac */
#define SEL(MOVEMENT) &kp LS(MOVEMENT)  /* Select text */

/* Jump to start or end of word regardless of cursor position */
#define MAC_START_OF_WD &kp MAC_WF &kp MAC_WB
#define MAC_END_OF_WD &kp MAC_WB &kp MAC_WF

/* We use LG(LEFT) / HOME twice to avoid an issue with IDEs being too smart and
   placing the cursor after the indenting whitespace */
#define MAC_START_OF_LN &kp MAC_HOME &kp MAC_HOME
#define MAC_START_OF_NEXT_LN &kp DOWN &kp MAC_HOME &kp MAC_HOME
#define MAC_SEL_START_OF_LN SEL(MAC_HOME) SEL(MAC_HOME)

/* Word select Macros for Mac */
SELECT_WORD_START_MACRO(sel_wd_fwd_mac, MAC_START_OF_WD, SEL(MAC_WF))
SELECT_WORD_START_MACRO(sel_wd_bwd_mac, MAC_END_OF_WD, SEL(MAC_WB))
SELECT_WORD_CONT_MACRO(cont_sel_wd_fwd_mac, SEL(MAC_WF))
SELECT_WORD_CONT_MACRO(cont_sel_wd_bwd_mac, SEL(MAC_WB))

/* Line select Macros for Mac */
SELECT_LINE_START_MACRO(sel_ln_fwd_mac, \
    MAC_START_OF_LN, SEL(DOWN), MAC_SEL_START_OF_LN)
SELECT_LINE_START_MACRO(sel_ln_bwd_mac, \
    MAC_START_OF_NEXT_LN, SEL(UP), MAC_SEL_START_OF_LN)
SELECT_LINE_CONT_MACRO(cont_sel_ln_fwd_mac, SEL(DOWN), MAC_SEL_START_OF_LN)
SELECT_LINE_CONT_MACRO(cont_sel_ln_bwd_mac, SEL(UP), MAC_SEL_START_OF_LN)


/* Glove80 system behavior & macros */
/ {
    behaviors {
        /* Let Caps Word continue when typing Underscore */
        caps_word {
            continue-list = <UNDERSCORE MINUS BACKSPACE DELETE N1 N2 N3 N4 N5 N6 N7 N8 N9 N0>;
        };

        // For the "layer" key, it'd nice to be able to use it as either a shift or a toggle.
        // Configure it as a tap dance, so the first tap (or hold) is a &mo and the second tap is a &to
        lower: lower {
            compatible = "zmk,behavior-tap-dance";
            label = "LAYER_TAP_DANCE";
            #binding-cells = <0>;
            tapping-term-ms = <200>;
            bindings = <&mo LAYER_Lower>, <&to LAYER_Lower>;
        };

        aksl: adaptive_key_sticky_layer {
            compatible = "zmk,behavior-sticky-key";
            #binding-cells = <1>;
            bindings = <&mo>;
            release-after-ms = <ADAPTIVE_LAYER_TIMEOUT_MS>;
            quick-release;
        };

        ascc: auto_shift_colcol {
            compatible = "zmk,behavior-hold-tap";
            #binding-cells = <2>;
            tapping_term_ms = <AUTOSHIFT_TAPPING_TERM_MS>;
            quick_tap_ms = <0>;
            flavor = "tap-preferred";
            bindings = <&colcol>, <&kp>;
        };

        // Format: &mt_* <HOLD> <TAP>
        mt_tmux: mod_tap_tmux {
            MOD_TAP_PROPS
            bindings = <&kp>, <&tmux_cmd>;
        };
        mt_vim_q: mod_tap_vim_q {
            MOD_TAP_PROPS
            bindings = <&kp>, <&vim_q>;
        };
        mt_vim_w: mod_tap_vim_w {
            MOD_TAP_PROPS
            bindings = <&kp>, <&vim_w>;
        };
        mt_caps_word: mod_tap_caps_word {
            MOD_TAP_PROPS
            bindings = <&kp>, <&caps_word>;
        };

        skat: sticky_key_alt_tab {
            compatible = "zmk,behavior-sticky-key";
            #binding-cells = <1>;
            bindings = <&kp>;
            release-after-ms = <ALT_TAB_TIMEOUT_MS>;
            quick-release;
            ignore-modifiers;
        };
    };
};

/ {
    macros {
        DIGRAM_MACRO(Q, U)
        DIGRAM_MACRO(T, H)
        DIGRAM_MACRO(C, H)
        DIGRAM_MACRO(S, H)
        DIGRAM_MACRO(W, H)
        DIGRAM_MACRO(G, H)
        DIGRAM_MACRO(P, H)

        AK_MACRO(A)
        AK_MACRO(C)
        AK_MACRO(G)
        AK_MACRO(P)
        AK_MACRO(B)
        AK_MACRO(D)
        AK_MACRO(M)
        AK_MACRO(U)
        AK_FIXUP_MACRO(L, V)
        AK_FIXUP_MACRO(L, B)

        ZMK_MACRO(colcol,
            bindings = <&kp COLON>, <&kp COLON>;
        )

        rgb_ug_status_macro: rgb_ug_status_macro {
            label = "RGB_UG_STATUS";
            compatible = "zmk,behavior-macro";
            #binding-cells = <0>;
            bindings
                = <&rgb_ug RGB_STATUS>;
        };

        // Tmux prefix (Ctrl-A in tmux.conf) + key
        tmux_cmd: tmux_cmd {
            compatible = "zmk,behavior-macro-one-param";
            #binding-cells = <1>;
            bindings = <&kp LC(A)>
                    , <&macro_param_1to1>
                    , <&kp MACRO_PLACEHOLDER>
                    ;
        };

        // :bn<CR>
        INST_VIM_CMD_MACRO(vim_bn, &kp B &kp N)
        // :bp<CR>
        INST_VIM_CMD_MACRO(vim_bp, &kp B &kp P)
        // :wincmd w<CR>
        INST_VIM_CMD_MACRO(vim_chwin, &kp W &kp I &kp N &kp C &kp M &kp D &kp SPACE &kp W)
        // :w<CR>
        INST_VIM_CMD_MACRO(vim_w, &kp W)
        // :q<CR>
        INST_VIM_CMD_MACRO(vim_q, &kp Q)

        ZMK_MACRO(alt_tab,
            bindings = <&macro_press &kp LALT>    // Leave ALT down to keep menu up
                    , <&macro_tap &kp TAB>       // Combines with shift fine
                    , <&macro_tap &skat LALT>    // This will release ALT after a timeout
                    , <&macro_release &kp LALT>  // Now release the previous hold
                    ;
        )
    };

    combos {
        
    };
};


/ {
#ifdef BT_DISC_CMD
    behaviors {
        bt_0: bt_0 {
            compatible = "zmk,behavior-tap-dance";
            label = "BT_0";
            #binding-cells = <0>;
            tapping-term-ms = <200>;
            bindings = <&bt_select_0>, <&bt BT_DISC 0>;
        };
        bt_1: bt_1 {
            compatible = "zmk,behavior-tap-dance";
            label = "BT_1";
            #binding-cells = <0>;
            tapping-term-ms = <200>;
            bindings = <&bt_select_1>, <&bt BT_DISC 1>;
        };
        bt_2: bt_2 {
            compatible = "zmk,behavior-tap-dance";
            label = "BT_2";
            #binding-cells = <0>;
            tapping-term-ms = <200>;
            bindings = <&bt_select_2>, <&bt BT_DISC 2>;
        };
        bt_3: bt_3 {
            compatible = "zmk,behavior-tap-dance";
            label = "BT_3";
            #binding-cells = <0>;
            tapping-term-ms = <200>;
            bindings = <&bt_select_3>, <&bt BT_DISC 3>;
        };
    };
    macros {
        bt_select_0: bt_select_0 {
            label = "BT_SELECT_0";
            compatible = "zmk,behavior-macro";
            #binding-cells = <0>;
            bindings
                = <&out OUT_BLE>,
                  <&bt BT_SEL 0>;
        };
        bt_select_1: bt_select_1 {
            label = "BT_SELECT_1";
            compatible = "zmk,behavior-macro";
            #binding-cells = <0>;
            bindings
                = <&out OUT_BLE>,
                  <&bt BT_SEL 1>;
        };
        bt_select_2: bt_select_2 {
            label = "BT_SELECT_2";
            compatible = "zmk,behavior-macro";
            #binding-cells = <0>;
            bindings
                = <&out OUT_BLE>,
                  <&bt BT_SEL 2>;
        };
        bt_select_3: bt_select_3 {
            label = "BT_SELECT_3";
            compatible = "zmk,behavior-macro";
            #binding-cells = <0>;
            bindings
                = <&out OUT_BLE>,
                  <&bt BT_SEL 3>;
        };
    };
#else
    macros {
        bt_0: bt_0 {
            label = "BT_0";
            compatible = "zmk,behavior-macro";
            #binding-cells = <0>;
            bindings
                = <&out OUT_BLE>,
                  <&bt BT_SEL 0>;
        };
        bt_1: bt_1 {
            label = "BT_1";
            compatible = "zmk,behavior-macro";
            #binding-cells = <0>;
            bindings
                = <&out OUT_BLE>,
                  <&bt BT_SEL 1>;
        };
        bt_2: bt_2 {
            label = "BT_2";
            compatible = "zmk,behavior-macro";
            #binding-cells = <0>;
            bindings
                = <&out OUT_BLE>,
                  <&bt BT_SEL 2>;
        };
        bt_3: bt_3 {
            label = "BT_3";
            compatible = "zmk,behavior-macro";
            #binding-cells = <0>;
            bindings
                = <&out OUT_BLE>,
                  <&bt BT_SEL 3>;
        };
    };
#endif
};

/ {
    behaviors {
        magic: magic {
            compatible = "zmk,behavior-hold-tap";
            label = "MAGIC_HOLD_TAP";
            #binding-cells = <2>;
            flavor = "tap-preferred";
            tapping-term-ms = <200>;
            bindings = <&mo>, <&rgb_ug_status_macro>;
        };
    };
};

/* #define for key positions */
#define POS_LH_T1 52
#define POS_LH_T2 53
#define POS_LH_T3 54
#define POS_LH_T4 69
#define POS_LH_T5 70
#define POS_LH_T6 71
#define POS_LH_C1R2 15
#define POS_LH_C1R3 27
#define POS_LH_C1R4 39
#define POS_LH_C1R5 51
#define POS_LH_C2R1 4
#define POS_LH_C2R2 14
#define POS_LH_C2R3 26
#define POS_LH_C2R4 38
#define POS_LH_C2R5 50
#define POS_LH_C2R6 68
#define POS_LH_C3R1 3
#define POS_LH_C3R2 13
#define POS_LH_C3R3 25
#define POS_LH_C3R4 37
#define POS_LH_C3R5 49
#define POS_LH_C3R6 67
#define POS_LH_C4R1 2
#define POS_LH_C4R2 12
#define POS_LH_C4R3 24
#define POS_LH_C4R4 36
#define POS_LH_C4R5 48
#define POS_LH_C4R6 66
#define POS_LH_C5R1 1
#define POS_LH_C5R2 11
#define POS_LH_C5R3 23
#define POS_LH_C5R4 35
#define POS_LH_C5R5 47
#define POS_LH_C5R6 65
#define POS_LH_C6R1 0
#define POS_LH_C6R2 10
#define POS_LH_C6R3 22
#define POS_LH_C6R4 34
#define POS_LH_C6R5 46
#define POS_LH_C6R6 64
#define POS_RH_T1 57
#define POS_RH_T2 56
#define POS_RH_T3 55
#define POS_RH_T4 74
#define POS_RH_T5 73
#define POS_RH_T6 72
#define POS_RH_C1R2 16
#define POS_RH_C1R3 28
#define POS_RH_C1R4 40
#define POS_RH_C1R5 58
#define POS_RH_C2R1 5
#define POS_RH_C2R2 17
#define POS_RH_C2R3 29
#define POS_RH_C2R4 41
#define POS_RH_C2R5 59
#define POS_RH_C2R6 75
#define POS_RH_C3R1 6
#define POS_RH_C3R2 18
#define POS_RH_C3R3 30
#define POS_RH_C3R4 42
#define POS_RH_C3R5 60
#define POS_RH_C3R6 76
#define POS_RH_C4R1 7
#define POS_RH_C4R2 19
#define POS_RH_C4R3 31
#define POS_RH_C4R4 43
#define POS_RH_C4R5 61
#define POS_RH_C4R6 77
#define POS_RH_C5R1 8
#define POS_RH_C5R2 20
#define POS_RH_C5R3 32
#define POS_RH_C5R4 44
#define POS_RH_C5R5 62
#define POS_RH_C5R6 78
#define POS_RH_C6R1 9
#define POS_RH_C6R2 21
#define POS_RH_C6R3 33
#define POS_RH_C6R4 45
#define POS_RH_C6R5 63
#define POS_RH_C6R6 79

/* Custom Defined Behaviors */
/ {

};

/* Automatically generated macro definitions */
/ {
    macros {
    
    };
};

/* Automatically generated keymap */
/ {
    keymap {
        compatible = "zmk,keymap";


        layer_HandsDownNeu {
            bindings = <
               &kp F1             &kp F2            &kp F3            &kp F4              &kp F5                                                                                                                                                                                        &kp F6            &kp F7            &kp F8         &as_f9_f10  &as_f11_f12
            &kp EQUAL             &kp N1            &kp N2            &kp N3              &kp N4  &kp N5                                                                                                                                        &kp N6                                  &kp N7            &kp N8            &kp N9             &kp N0    &kp MINUS
              &kp TAB              &kp W             &kp F             &AK_M               &AK_P   &kp V                                                                                                                                     &as_fs_cm                               &as_am_dt             &kp Q         &as_qm_ex          &as_dq_sq        &kp Z
              &kp ESC  &lh_hr_mt LCTRL R  &lh_hr_mt LALT S  &lh_hr_mt LGUI N  &lh_hr_mt LSHIFT T   &AK_B                                                                                                                                     &as_cl_sm  &rh_hr_mt_aka RSHIFT A  &rh_hr_mt RGUI E  &rh_hr_mt LALT I  &rh_hr_mt RCTRL H        &kp J
            &kp LG(A)              &kp X             &AK_C             &kp L               &AK_D   &AK_G               &lshft_caps                     &none  &lower  &lower                         &none               &rshft_bspcwd_mac  &as_mn_und                                   &AK_U             &kp O             &kp Y              &kp K    &kp PG_UP
 &magic LAYER_Magic 0           &kp LEFT          &kp DOWN            &kp UP           &kp RIGHT          &rt_lt LAYER_Cursor BSPC  &fst_lt LAYER_Number TAB   &none   &none  &fst_lt LAYER_Function ENTER  &fst_lt LAYER_Symbol SPACE                                            &kp LEFT          &kp DOWN            &kp UP          &kp RIGHT    &kp PG_DN
            >;
        };

        layer_QWERTY {
            bindings = <
               &kp F1             &kp F2            &kp F3            &kp F4              &kp F5                                                                                                                                                                &kp F6            &kp F7            &kp F8            &as_f9_f10  &as_f11_f12
            &kp EQUAL             &kp N1            &kp N2            &kp N3              &kp N4  &kp N5                                                                                                                                    &kp N6              &kp N7            &kp N8            &kp N9                &kp N0    &kp MINUS
              &kp TAB              &kp Q             &kp W             &kp E               &kp R   &kp T                                                                                                                                     &kp Y               &kp U             &kp I             &kp O                 &kp P     &kp BSLH
              &kp ESC  &lh_hr_mt LCTRL A  &lh_hr_mt LALT S  &lh_hr_mt LGUI D  &lh_hr_mt LSHIFT F   &kp G                                                                                                                                     &kp H  &rh_hr_mt RSHIFT J  &rh_hr_mt RGUI K  &rh_hr_mt LALT L  &rh_hr_mt RCTRL SEMI      &kp SQT
            &kp LG(A)              &kp Z             &kp X             &kp C               &kp V   &kp B               &lshft_caps                     &none  &lower  &lower                         &none               &rshft_bspcwd_mac   &kp N               &kp M         &kp COMMA           &kp DOT              &kp FSLH    &kp PG_UP
 &magic LAYER_Magic 0           &kp LEFT          &kp DOWN            &kp UP           &kp RIGHT          &rt_lt LAYER_Cursor BSPC  &fst_lt LAYER_Number TAB   &none   &none  &fst_lt LAYER_Function ENTER  &fst_lt LAYER_Symbol SPACE                    &kp LEFT          &kp DOWN            &kp UP             &kp RIGHT    &kp PG_DN
            >;
        };

        layer_Symbol {
            bindings = <
               &trans     &trans     &trans     &trans    &trans                                                                                                  &trans     &trans     &trans  &trans  &trans
            &kp GRAVE     &trans     &trans     &trans    &trans     &trans                                                                            &trans     &trans     &trans     &trans  &trans  &trans
              &kp SQT   &kp LBKT   &kp LBRC   &kp RBRC  &kp RBKT   &kp PLUS                                                                            &trans   &kp AMPS   &kp STAR   &kp HASH  &trans  &trans
             &kp EXCL  &kp CARET   &kp LPAR   &kp RPAR  &kp DLLR  &kp QMARK                                                                            &trans  &kp LSHFT  &kp LCTRL  &kp GRAVE  &trans  &trans
             &kp HASH     &kp LT  &kp EQUAL  &kp MINUS    &kp GT   &kp STAR   &kp BSLH                         &trans  &trans  &trans  &trans  &trans  &trans     &trans     &trans     &trans  &trans  &trans
 &magic LAYER_Magic 0  &kp TILDE   &kp PIPE   &kp FSLH   &kp DOT             &kp PRCNT  &ascc MACRO_PLACEHOLDER COLON  &kp AT  &tog 2  &trans  &trans             &trans     &trans     &trans  &trans  &trans
            >;
        };

        layer_Number {
            bindings = <
               &trans  &trans     &trans     &trans     &trans                                                                                 &trans     &trans    &trans     &trans     &trans
               &trans  &trans     &trans     &trans     &trans       &trans                                                      &kp TILDE  &kp CARET   &kp HASH  &kp DLLR     &kp AT     &trans
               &trans  &trans  &kp LS(G)      &kp K     &trans       &trans                                                      &kp PRCNT     &kp N7     &kp N8    &kp N9  &kp COLON      &kp K
           &kp KP_NUM  &trans   &kp LALT  &kp LCTRL  &kp LSHFT  &tmux_cmd S                                                       &kp PLUS     &kp N4     &kp N5    &kp N6  &kp MINUS      &kp J
               &trans  &trans     &trans      &kp J  &kp LC(A)  &tmux_cmd Q  &trans  &trans  &trans  &trans  &kp LC(A)  &kp DOT   &kp STAR     &kp N1     &kp N2    &kp N3   &kp FSLH  &kp LS(G)
 &magic LAYER_Magic 0  &trans     &trans     &trans     &trans               &trans  &trans  &tog 3  &trans  &kp COMMA   &kp N0                &kp LT  &kp EQUAL    &kp GT      &kp T      &kp F
            >;
        };

        layer_Function {
            bindings = <
               &trans  &trans  &trans  &trans  &trans                                                                                           &trans                          &trans                              &trans  &trans           &trans
               &trans  &trans  &trans  &trans  &trans  &trans                                                  &kp DEL                         &kp F10                         &kp F11                             &kp F12  &trans           &trans
               &trans  &trans  &trans  &trans  &trans  &trans                                                  &kp INS                          &kp F7                          &kp F8                              &kp F9  &trans           &trans
             &kp CAPS  &trans  &trans  &trans  &trans  &trans                                                   &trans  &mt_vim_q F4 MACRO_PLACEHOLDER  &mt_vim_w F5 MACRO_PLACEHOLDER  &mt_caps_word F6 MACRO_PLACEHOLDER  &trans         &kp SLCK
               &trans  &trans  &trans  &trans  &trans  &trans  &trans  &trans  &trans  &trans  &trans  &trans   &trans                   &mt_tmux F1 X            &mt_tmux F2 KP_MINUS                       &mt_tmux F3 V  &trans        &kp PSCRN
 &magic LAYER_Magic 0  &trans  &trans  &trans  &trans          &trans  &trans  &tog 4  &trans  &trans  &trans                                   &trans                          &trans                              &trans  &trans  &kp PAUSE_BREAK
            >;
        };

        layer_Cursor {
            bindings = <
               &trans     &trans    &trans      &trans     &trans                                                                                       &trans           &trans           &trans             &trans  &trans
               &trans     &trans    &trans  &vim_chwin     &trans     &trans                                                           &trans           &trans           &trans           &trans             &trans  &trans
               &trans     &trans  &alt_tab     &vim_bp    &vim_bn    &kp TAB                                                         &kp HOME        &kp PG_DN        &kp PG_UP          &kp END          &kp LG(X)  &trans
               &trans  &sk LCTRL  &sk LALT    &sk LGUI  &sk LSHFT  &kp SPACE                                                         &kp LEFT         &kp DOWN           &kp UP        &kp RIGHT  &copy_sel_all_mac  &trans
               &trans     &trans    &trans      &trans  &kp LC(A)    &kp RET  &trans  &trans  &trans  &trans  &trans  &trans  &sel_wd_bwd_mac  &sel_ln_fwd_mac  &sel_ln_bwd_mac  &sel_wd_fwd_mac    &paste_undo_mac  &trans
 &magic LAYER_Magic 0     &trans    &trans      &trans     &trans             &trans  &trans  &tog 5  &trans  &trans  &trans                            &trans           &trans           &trans             &trans  &trans
            >;
        };

        layer_SelectCont {
            bindings = <
  &trans   &trans   &trans   &trans   &trans                                                                                 &trans                 &trans                 &trans                &trans  &trans
  &trans   &trans   &trans   &trans   &trans   &trans                                                   &trans                 &trans                 &trans                 &trans                &trans  &trans
  &trans  &trans  &trans  &trans  &trans  &trans                                                  &trans                &trans                &trans                &trans                &trans   &trans
  &trans  &trans  &trans  &trans  &trans  &trans                                                  &trans                &trans                &trans                &trans                &trans   &trans
  &trans  &trans  &trans  &trans  &trans  &trans  &trans   &trans   &trans   &trans   &trans  &trans  &cont_sel_wd_bwd_mac  &cont_sel_ln_fwd_mac  &cont_sel_ln_bwd_mac  &cont_sel_wd_fwd_mac  &trans   &trans
 &trans   &trans   &trans   &trans   &trans          &trans  &trans   &trans   &trans  &trans  &trans                         &trans                 &trans                 &trans                 &trans   &trans
            >;
        };

        layer_SelectContSL {
            bindings = <
  &trans   &trans   &trans   &trans   &trans                                                                   &trans   &trans   &trans  &trans  &trans
  &trans   &trans   &trans   &trans   &trans   &trans                                                   &trans   &trans   &trans   &trans  &trans  &trans
  &trans  &trans  &trans  &trans  &trans  &trans                                                  &trans  &trans  &trans  &trans  &trans   &trans
  &trans  &trans  &trans  &trans  &trans  &trans                                                  &trans  &trans  &trans  &trans  &trans   &trans
  &trans  &trans  &trans  &trans  &trans  &trans  &trans   &trans   &trans   &trans   &trans  &trans  &trans  &trans  &trans  &trans  &trans   &trans
 &trans   &trans   &trans   &trans   &trans          &trans  &trans   &trans   &trans  &trans  &trans           &trans   &trans   &trans   &trans   &trans
            >;
        };

        layer_Mouse {
            bindings = <
 &trans  &trans  &trans  &trans  &trans                                                                  &trans  &trans  &trans  &trans  &trans
 &trans  &trans  &trans  &trans  &trans  &trans                                                  &trans  &trans  &trans  &trans  &trans  &trans
 &trans  &trans  &trans  &trans  &trans  &trans                                                  &trans  &trans  &trans  &trans  &trans  &trans
 &trans  &trans  &trans  &trans  &trans  &trans                                                  &trans  &trans  &trans  &trans  &trans  &trans
 &trans  &trans  &trans  &trans  &trans  &trans  &mkp 2  &trans  &trans  &trans  &trans  &trans  &trans  &trans  &trans  &trans  &trans  &trans
 &trans  &trans  &trans  &trans  &trans          &mkp 0  &mkp 1  &trans  &tog 6  &trans  &trans          &trans  &trans  &trans  &trans  &trans
            >;
        };

        layer_akl_A {
            bindings = <
 &trans  &trans  &trans  &trans  &trans                                                                  &trans  &trans  &trans  &trans  &trans
 &trans  &trans  &trans  &trans  &trans  &trans                                                  &trans  &trans  &trans  &trans  &trans  &trans
 &trans  &trans  &trans  &trans  &trans  &trans                                                  &trans  &trans  &trans  &trans  &trans  &trans
 &trans  &trans  &trans  &trans  &trans  &trans                                                   &kp U  &trans  &trans  &trans  &trans  &trans
 &trans  &trans  &trans  &trans  &trans  &trans  &trans  &trans  &trans  &trans  &trans  &trans  &trans  &trans  &trans  &trans  &trans  &trans
 &trans  &trans  &trans  &trans  &trans          &trans  &trans  &trans  &trans  &trans  &trans          &trans  &trans  &trans  &trans  &trans
            >;
        };

        layer_akl_C {
            bindings = <
 &trans  &trans  &trans  &trans  &trans                                                                  &trans  &trans  &trans  &trans  &trans
 &trans  &trans  &trans  &trans  &trans  &trans                                                  &trans  &trans  &trans  &trans  &trans  &trans
 &trans  &trans  &trans  &trans  &trans  &trans                                                  &trans  &trans  &trans  &trans  &trans  &trans
 &trans  &trans  &trans   &kp D  &trans  &trans                                                  &trans  &trans  &trans  &trans  &trans  &trans
 &trans  &trans  &trans  &trans  &trans   &kp P  &trans  &trans  &trans  &trans  &trans  &trans  &trans  &trans  &trans  &trans  &trans  &trans
 &trans  &trans  &trans  &trans  &trans          &trans  &trans  &trans  &trans  &trans  &trans          &trans  &trans  &trans  &trans  &trans
            >;
        };

        layer_akl_G {
            bindings = <
 &trans  &trans  &trans  &trans  &trans                                                                  &trans  &trans  &trans  &trans  &trans
 &trans  &trans  &trans  &trans  &trans  &trans                                                  &trans  &trans  &trans  &trans  &trans  &trans
 &trans  &trans  &trans   &kp L  &trans  &trans                                                  &trans  &trans  &trans  &trans  &trans  &trans
 &trans  &trans  &trans  &trans  &trans  &trans                                                  &trans  &trans  &trans  &trans  &trans  &trans
 &trans  &trans  &trans  &trans  &trans  &trans  &trans  &trans  &trans  &trans  &trans  &trans  &trans  &trans  &trans  &trans  &trans  &trans
 &trans  &trans  &trans  &trans  &trans          &trans  &trans  &trans  &trans  &trans  &trans          &trans  &trans  &trans  &trans  &trans
            >;
        };

        layer_akl_P {
            bindings = <
 &trans  &trans  &trans  &trans  &trans                                                                  &trans  &trans  &trans  &trans  &trans
 &trans  &trans  &trans  &trans  &trans  &trans                                                  &trans  &trans  &trans  &trans  &trans  &trans
 &trans  &trans  &trans   &kp L  &trans  &AK_LV                                                  &trans  &trans  &trans  &trans  &trans  &trans
 &trans  &trans  &trans  &trans  &trans  &trans                                                  &trans  &trans  &trans  &trans  &trans  &trans
 &trans  &trans  &trans  &trans  &trans  &trans  &trans  &trans  &trans  &trans  &trans  &trans  &trans  &trans  &trans  &trans  &trans  &trans
 &trans  &trans  &trans  &trans  &trans          &trans  &trans  &trans  &trans  &trans  &trans          &trans  &trans  &trans  &trans  &trans
            >;
        };

        layer_akl_B {
            bindings = <
 &trans  &trans  &trans  &trans  &trans                                                                  &trans  &trans  &trans  &trans  &trans
 &trans  &trans  &trans  &trans  &trans  &trans                                                  &trans  &trans  &trans  &trans  &trans  &trans
 &trans  &trans  &trans   &kp L  &trans  &trans                                                  &trans  &trans  &trans  &trans  &trans  &trans
 &trans  &trans  &trans  &trans   &kp L  &trans                                                  &trans  &trans  &trans  &trans  &trans  &trans
 &trans  &trans  &trans  &trans  &trans  &trans  &trans  &trans  &trans  &trans  &trans  &trans  &trans  &trans  &trans  &trans  &trans  &trans
 &trans  &trans  &trans  &trans  &trans          &trans  &trans  &trans  &trans  &trans  &trans          &trans  &trans  &trans  &trans  &trans
            >;
        };

        layer_akl_D {
            bindings = <
 &trans  &trans  &trans  &trans  &trans                                                                  &trans  &trans  &trans  &trans  &trans
 &trans  &trans  &trans  &trans  &trans  &trans                                                  &trans  &trans  &trans  &trans  &trans  &trans
 &trans  &trans  &trans  &trans  &trans  &trans                                                  &trans  &trans  &trans  &trans  &trans  &trans
 &trans  &trans  &trans  &trans  &trans  &AK_LB                                                  &trans  &trans  &trans  &trans  &trans  &trans
 &trans  &trans  &trans  &trans  &trans  &trans  &trans  &trans  &trans  &trans  &trans  &trans  &trans  &trans  &trans  &trans  &trans  &trans
 &trans  &trans  &trans  &trans  &trans          &trans  &trans  &trans  &trans  &trans  &trans          &trans  &trans  &trans  &trans  &trans
            >;
        };

        layer_akl_M {
            bindings = <
 &trans  &trans  &trans  &trans  &trans                                                                  &trans  &trans  &trans  &trans  &trans
 &trans  &trans  &trans  &trans  &trans  &trans                                                  &trans  &trans  &trans  &trans  &trans  &trans
 &trans  &trans  &trans  &trans  &trans   &AK_B                                                  &trans  &trans  &trans  &trans  &trans  &trans
 &trans  &trans  &trans  &trans  &trans  &trans                                                  &trans  &trans  &trans  &trans  &trans  &trans
 &trans  &trans  &trans  &trans  &trans  &trans  &trans  &trans  &trans  &trans  &trans  &trans  &trans  &trans  &trans  &trans  &trans  &trans
 &trans  &trans  &trans  &trans  &trans          &trans  &trans  &trans  &trans  &trans  &trans          &trans  &trans  &trans  &trans  &trans
            >;
        };

        layer_akl_U {
            bindings = <
 &trans  &trans  &trans  &trans  &trans                                                                  &trans  &trans  &trans  &trans  &trans
 &trans  &trans  &trans  &trans  &trans  &trans                                                  &trans  &trans  &trans  &trans  &trans  &trans
 &trans  &trans  &trans  &trans  &trans  &trans                                                  &trans  &trans  &trans  &trans  &trans  &trans
 &trans  &trans  &trans  &trans  &trans  &trans                                                  &trans  &trans  &trans  &trans  &trans  &trans
 &trans  &trans  &trans  &trans  &trans  &trans  &trans  &trans  &trans  &trans  &trans  &trans   &kp A  &trans  &trans  &trans  &trans  &trans
 &trans  &trans  &trans  &trans  &trans          &trans  &trans  &trans  &trans  &trans  &trans          &trans  &trans  &trans  &trans  &trans
            >;
        };

        layer_Lower {
            bindings = <
               &trans  &trans  &trans  &trans  &trans                                                                  &trans  &trans  &trans  &trans  &trans
               &trans  &trans  &trans  &trans  &trans  &trans                                                  &trans  &trans  &trans  &trans  &trans  &trans
               &trans  &trans  &trans  &trans  &trans  &trans                                                  &trans  &trans  &trans  &trans  &trans  &trans
               &trans  &trans  &trans  &trans  &trans  &trans                                                  &trans  &trans  &trans  &trans  &trans  &trans
               &trans  &trans  &trans  &trans  &trans  &trans  &tog 4  &trans  &trans  &trans  &trans  &trans  &trans  &trans  &trans  &trans  &trans  &trans
 &magic LAYER_Magic 0  &trans  &trans  &trans  &trans          &tog 5  &tog 3  &trans  &trans  &trans  &tog 2          &trans  &trans  &trans  &trans  &trans
            >;
        };

        layer_Magic {
            bindings = <
  &bt BT_CLR            &none            &none            &none            &none                                                                                  &none   &none   &none   &none  &bt BT_CLR_ALL
       &to 0            &to 1            &none            &none            &none            &none                                                         &none   &none   &none   &none   &none           &none
       &none  &rgb_ug RGB_SPI  &rgb_ug RGB_SAI  &rgb_ug RGB_HUI  &rgb_ug RGB_BRI  &rgb_ug RGB_TOG                                                         &none   &none   &none   &none   &none           &none
 &bootloader  &rgb_ug RGB_SPD  &rgb_ug RGB_SAD  &rgb_ug RGB_HUD  &rgb_ug RGB_BRD  &rgb_ug RGB_EFF                                                         &none   &none   &none   &none   &none     &bootloader
  &sys_reset            &none            &none            &none            &none            &none   &bt_2   &bt_3         &none   &none   &none   &none   &none   &none   &none   &none   &none      &sys_reset
       &none            &none            &none            &none            &none                    &bt_0   &bt_1  &out OUT_USB   &none   &none   &none           &none   &none   &none   &none           &none
            >;
        };

    };
};
